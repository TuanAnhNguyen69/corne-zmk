## boards/shields/corne42_left/Kconfig.defconfig
```kconfig
if SHIELD_CORNE42_LEFT || SHIELD_CORNE42_RIGHT

config ZMK_SPLIT
    default y

endif
```

## boards/shields/corne42_left/Kconfig.shield
```kconfig
config SHIELD_CORNE42_LEFT
    def_bool $(shields_list_contains,corne42_left)
config SHIELD_CORNE42_RIGHT
    def_bool $(shields_list_contains,corne42_right)
```
